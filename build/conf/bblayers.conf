## build/conf/bblayers.conf
```bitbake
# POKY_BBLAYERS_CONF_VERSION is increased each time build/conf/bblayers.conf
# changes incompatibly
POKY_BBLAYERS_CONF_VERSION = "2"

BBPATH = "${TOPDIR}"
BBFILES ?= ""

BBLAYERS ?= " \
  /storage/mika/clean-updater/poky/meta \
  /storage/mika/clean-updater/poky/meta-poky \
  /storage/mika/clean-updater/poky/meta-yocto-bsp \
  /storage/mika/clean-updater/poky/meta-updater \
  /storage/mika/clean-updater/poky/meta-updater-raspberrypi \
  "
METADIR  := "${@os.path.abspath('/storage/mika/clean-updater/poky')}"

BBLAYERS += "${METADIR}/meta-updater"
BBLAYERS += "${METADIR}/meta-openembedded/meta-filesystems"
BBLAYERS += "${METADIR}/meta-openembedded/meta-python"
BBLAYERS += "${METADIR}/meta-openembedded/meta-oe"
BBLAYERS += "${METADIR}/meta-rust"

BBLAYERS += " ${METADIR}/meta-updater-raspberrypi ${METADIR}/meta-raspberrypi "
```
